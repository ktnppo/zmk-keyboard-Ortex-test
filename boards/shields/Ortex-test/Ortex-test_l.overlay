#include "Ortex-test.dtsi"

&kscan0 {
        row-gpios
            = <&gpio0 10 GPIO_ACTIVE_HIGH>
            , <&gpio0 31 GPIO_ACTIVE_HIGH> 
            , <&gpio0 16 GPIO_ACTIVE_HIGH> 
            , <&gpio1 00 GPIO_ACTIVE_HIGH> 
            , <&gpio1 10 GPIO_ACTIVE_HIGH> 
            , <&xiao_d 4 GPIO_ACTIVE_HIGH>
            , <&xiao_d 5 GPIO_ACTIVE_HIGH>
            , <&xiao_d 6 GPIO_ACTIVE_HIGH>
            ;

        col-gpios
            = <&xiao_d 7 GPIO_ACTIVE_HIGH>
            , <&xiao_d 8 GPIO_ACTIVE_HIGH> 
            , <&xiao_d 9 GPIO_ACTIVE_HIGH> 
            , <&xiao_d 10 GPIO_ACTIVE_HIGH> 
            , <&xiao_d 3 GPIO_ACTIVE_HIGH>
            ;
};

&left_encoder {
    status = "okay";
};
