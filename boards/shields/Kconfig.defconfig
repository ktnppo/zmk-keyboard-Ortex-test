## boards/shields/Kconfig.defconfig
```kconfig
if SHIELD_Ortex-test_RIGHT

config ZMK_KEYBOARD_NAME
    default "Ortex-test"
config ZMK_SPLIT_ROLE_CENTRAL
    default y
endif

if SHIELD_Ortex-test_LEFT || SHIELD_Ortex-test_RIGHT
config ZMK_SPLIT
    default y
endif
```

## boards/shields/Kconfig.shield
```kconfig
config SHIELD_Ortex-test_LEFT
   def_bool $(shields_list_contains,Ortex-test_left)

config SHIELD_Ortex-test_RIGHT
   def_bool $(shields_list_contains,Ortex-test_right)
```

## boards/shields/Ortex-test/Kconfig.defconfig
```kconfig
if SHIELD_Ortex-test_RIGHT

config ZMK_KEYBOARD_NAME
    default "Ortex-test"

config ZMK_BLE
    default y

config ZMK_SPLIT_ROLE_CENTRAL
    default y

config INPUT
    default y

config ZMK_POINTING
    default y

config SPI
    default y

config PMW3610
    default y

endif

if SHIELD_Ortex-test_LEFT || SHIELD_Ortex-test_RIGHT
config NFCT_PINS_AS_GPIOS
    default y

config ZMK_SPLIT
    default y

endif
```

## boards/shields/Ortex-test/Kconfig.shield
```kconfig
config SHIELD_ortex_test_l
   def_bool $(shields_list_contains,ortex_test_l)

config SHIELD_ortex_test_r
   def_bool $(shields_list_contains,ortex_test_r)
```

## boards/shields/ortex_test/Kconfig.defconfig
```kconfig
if SHIELD_ORTEX_TEST_R

config ZMK_KEYBOARD_NAME
    default "ortex_test"

config ZMK_BLE
    default y

config ZMK_SPLIT_ROLE_CENTRAL
    default y

config INPUT
    default y

config ZMK_POINTING
    default y

config SPI
    default y

config PMW3610_ALT
    default y

endif

if SHIELD_ORTEX_TEST_L || SHIELD_ORTEX_TEST_R
config ZMK_SPLIT
    default y

endif
```

## boards/shields/ortex_test/Kconfig.shield
```kconfig
config SHIELD_ORTEX_TEST_L
   def_bool $(shields_list_contains,ortex_test_l)

config SHIELD_ORTEX_TEST_R
   def_bool $(shields_list_contains,ortex_test_r)
```
